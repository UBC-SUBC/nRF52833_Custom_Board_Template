## app-v_0_0/build/Kconfig/Kconfig.shield
```kconfig
osource "/home/thomas/SUBC/nRF52833_Custom_Board_Template/boards/shields/*/Kconfig.shield"
osource "/home/thomas/ncs/v2.6.0/nrf/boards/shields/*/Kconfig.shield"
```

## app-v_0_0/build/Kconfig/Kconfig.shield.defconfig
```kconfig
osource "/home/thomas/SUBC/nRF52833_Custom_Board_Template/boards/shields/*/Kconfig.defconfig"
osource "/home/thomas/ncs/v2.6.0/nrf/boards/shields/*/Kconfig.defconfig"
```

## app-v_0_0/build/Kconfig/Kconfig.sysbuild.modules
```kconfig
menu "nrf (/home/thomas/ncs/v2.6.0/nrf)"
osource "/home/thomas/ncs/v2.6.0/nrf/sysbuild/Kconfig.sysbuild"
config ZEPHYR_NRF_MODULE
	bool
	default y
endmenu
```

## boards/arm/bc833m_nrf52833/Kconfig.board
```kconfig
# Copyright (c) 2024 Nordic Semiconductor ASA
# SPDX-License-Identifier: Apache-2.0

config BOARD_BC833M_NRF52833
	bool "BC833M nRF52833"
	depends on SOC_NRF52833_QIAA
```

## boards/arm/bc833m_nrf52833/Kconfig.defconfig
```kconfig
# Copyright (c) 2024 Nordic Semiconductor ASA
# SPDX-License-Identifier: Apache-2.0

if BOARD_BC833M_NRF52833

config BOARD
	default "bc833m_nrf52833"

config BT_CTLR
   default BT

config BC833_HW_VERSION_0_1_0
	bool "Selected hardware 0.1.0"
	default n

endif
```

## boards/arm/bc833m_nrf52833/bc833m_nrf52833_defconfig
```kconfig
# Copyright (c) 2024 Nordic Semiconductor ASA
# SPDX-License-Identifier: Apache-2.0

CONFIG_SOC_SERIES_NRF52X=y
CONFIG_SOC_NRF52833_QIAA=y
CONFIG_BOARD_BC833M_NRF52833=y

# Enable MPU
CONFIG_ARM_MPU=y

# Enable hardware stack protection
CONFIG_HW_STACK_PROTECTION=y

CONFIG_USE_SEGGER_RTT=y

CONFIG_GPIO=y

CONFIG_SERIAL=y

CONFIG_CONSOLE=y
CONFIG_UART_CONSOLE=y

CONFIG_PINCTRL=y


# This symbol is depreciated (Change when we update to the device tree 2.0)
CONFIG_NFCT_PINS_AS_GPIOS=y 
```
